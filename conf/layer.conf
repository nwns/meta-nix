## conf/layer.conf
```bitbake
# We have a conf and classes directory, add to BBPATH
BBPATH .= ":${LAYERDIR}"

# We have recipes-* directories, add to BBFILES
BBFILES += "${LAYERDIR}/recipes-*/*/*.bb \
            ${LAYERDIR}/recipes-*/*/*.bbappend"

BBFILE_COLLECTIONS += "meta-nix"
BBFILE_PATTERN_meta-nix = "^${LAYERDIR}/"
BBFILE_PRIORITY_meta-nix = "6"

LAYERDEPENDS_meta-nix = "core"
LAYERSERIES_COMPAT_meta-nix = "nanbield"
```
